## conf/bblayers.conf.sample
```bitbake
# POKY_BBLAYERS_CONF_VERSION is increased each time build/conf/bblayers.conf
# changes incompatibly
POKY_BBLAYERS_CONF_VERSION = "2"

BBPATH = "${TOPDIR}"
BBFILES ?= ""

GEOPHONE_LAYERS = "${@os.path.abspath(os.path.join("${TOPDIR}", os.pardir))}"

BBLAYERS ?= " \
    ${GEOPHONE_LAYERS}/geophone/meta \
    ${GEOPHONE_LAYERS}/geophone/meta-poky \
    ${GEOPHONE_LAYERS}/geophone/meta-openembedded/meta-oe \
    ${GEOPHONE_LAYERS}/geophone/meta-openembedded/meta-multimedia \
    ${GEOPHONE_LAYERS}/geophone/meta-openembedded/meta-networking \
    ${GEOPHONE_LAYERS}/geophone/meta-openembedded/meta-perl \
    ${GEOPHONE_LAYERS}/geophone/meta-openembedded/meta-python \
    ${GEOPHONE_LAYERS}/geophone/meta-openembedded/meta-webserver \
    ${GEOPHONE_LAYERS}/geophone/meta-raspberrypi \
    ${GEOPHONE_LAYERS}/geophone/meta-geophone \
"
```

## conf/layer.conf
```bitbake
# We have a conf and classes directory, append to BBPATH
BBPATH .= ":${LAYERDIR}"

# We have a recipes directory, add to BBFILES
BBFILES:append = "${LAYERDIR}/recipes*/*/*.bb \
                ${LAYERDIR}/recipes*/*/*.bbappend \ 
                ${LAYERDIR}/recipes*/*/*/*.bbappend \ 
                ${LAYERDIR}/images/*.bb \
                "

BBFILE_COLLECTIONS += "meta-geophone"
BBFILE_PATTERN:meta-geophone := "^${LAYERDIR}/"
BBFILE_PRIORITY:meta-geophone = "16"

LAYERSERIES_COMPAT:meta-geophone = "mickledore nanbield"
```
